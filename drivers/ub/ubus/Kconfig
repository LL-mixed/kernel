## drivers/ub/ubus/Kconfig
```kconfig
# SPDX-License-Identifier: GPL-2.0+
#
# UB bus driver configuration
#

menuconfig UB_UBUS
	default n
	bool "UBUS support"
	depends on UB
	help
	  This option enables support for UB bus device management
	  functionality, providing fundamental capabilities such as
	  UB bus registration, device registration, and driver registration.
	  It configures and enables devices, offering device capabilities
	  to the upper layers.
	  Say 'Y' here unless you know what you are doing.

if UB_UBUS

config UB_UBUS_BUS
	default y
	tristate "UB Bus Driver Modular Section"
	depends on UB_UBUS
	help
	  This option controls the ubus core object that complements the
	  built-in ubus support under drivers/ub/ubus/.
	  For QEMU/simulation environments, keep this enabled as built-in.
	  Select 'M' only when you intentionally need a loadable split.

config UB_UBUS_USI
	default n
	bool "UBUS Message Signaled Interrupts (USI)"
	depends on UB_UBUS
	select GENERIC_MSI_IRQ
	help
		This allows device drivers to enable MSI (Message Signaled
		Interrupts).  Message Signaled Interrupts enable a device to
		generate an interrupt using an inbound Memory Write on its
		UnifiedBus instead of asserting a device IRQ pin.If you
		don't know what to do here, say Y.

config UB_UBUS_SIM_DECODER
	default y
	bool "UBUS Simulation Decoder for Cross-Node Memory Access"
	depends on UB_UBUS && UB_UBUS_BUS && OBMM
	help
		Enable simulation decoder driver for QEMU/UB dual-node
		cross-node memory access. This driver provides decoder
		configuration over simulation control channels.
		Say 'Y' here for QEMU simulation environments.

source "drivers/ub/ubus/vendor/Kconfig"

endif
```

## drivers/ub/ubus/vendor/Kconfig
```kconfig
# SPDX-License-Identifier: GPL-2.0+

menu "UB vendor drivers"
	depends on UB_UBUS

config UB_HISI_UBUS
	tristate "hisilicon ubus"
	depends on UB_UBUS_BUS
	depends on UB_UBUS_USI
	default y
	help
	  This option enables the HiSilicon ubus vendor implementation.
	  For QEMU/simulation environments that rely on vendor private control
	  messages, keep this enabled as built-in.
	  Select 'M' only when you intentionally want a loadable split.

endmenu
```
